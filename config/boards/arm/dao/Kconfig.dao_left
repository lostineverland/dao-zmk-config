## config/boards/arm/dao/Kconfig.dao_left
```kconfig
# Copyright (c) 2021 Rafael Yumagulov
# SPDX-License-Identifier: MIT

config BOARD_DAO_LEFT
	select SOC_NRF52840_QIAA
	select ZMK_BOARD_COMPAT
```

## config/boards/arm/dao/board.yml
```yaml
boards:
  - name: dao_left
    vendor: zmk
    socs:
      - name: nrf52840
  - name: dao_right
    vendor: zmk
    socs:
      - name: nrf52840
```
